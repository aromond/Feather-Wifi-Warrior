//NodeMCU  Wemos D1
//Arduino as ISP
#include <SPI.h>
#include <NTPClient.h>
#include <ESP8266WiFi.h>
#include <WiFiUdp.h>
#include <Adafruit_NeoPixel.h>
#include <TimeLib.h>

#include <DNSServer.h>
#include <ESP8266WebServer.h>
#include <WiFiManager.h>

#include <EEPROM.h>

#define LED_PIN D6
#define LED_COUNT 6

int utc=0;
bool displaySwitch=true;
unsigned int pause = 0;
unsigned long timeout;
//unsigned long newNTPreq;
unsigned long secondTick;
bool dst = false;
int minTmp;

static uint16_t hue = 0; // 0-359
uint8_t saturation = 100; // 0-100
uint8_t lightness = 50; // 0-100
unsigned int PColor=0;

const char *ssid     = "Camp G&P";
const char *password = "seashell";

long utcOffsetInSeconds = 3600*utc;

// /header.html
const char data_header_html[] PROGMEM = {0X3C,0X68,0X74,0X6D,0X6C,0X3E,0X3C,0X68,0X65,0X61,0X64,0X3E,0X3C,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0X0A,0X00};

// /footer.html
const char data_footer_html[] PROGMEM = {0x3c,0x2f,0x63,0x65,0x6e,0x74,0x65,0x72,0x3e,0X3c,0X2f,0X62,0X6f,0X64,0X79,0X3e,0X0a,0X3c,0X2f,0X68,0X74,0X6d,0X6c,0X3e,0X0a,0x00};

// /body.html
const char data_body_html[] PROGMEM = {0X3C,0X66,0X6F,0X72,0X6D,0X20,0X61,0X63,0X74,0X69,0X6F,0X6E,0X3D,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0XA,0x00};

WiFiManager wifiManager;

WiFiServer server(80);
WiFiUDP ntpUDP;
NTPClient timeClient(ntpUDP, "pool.ntp.org");
Adafruit_NeoPixel strip(LED_COUNT, LED_PIN, NEO_GRB + NEO_KHZ800);

String header = "HTTP/1.1 200 OK\r\nContent-Type: text/html\r\n\r\n";
String request = "";

//wemos
const int dataPin = 14;  //D5 //Outputs the byte to transfer
const int loadPin = 0;   //D3 //3 //Controls the internal transference of data in SN74HC595 internal registers
const int clockPin = 4;  //D2 // 4//Generates the clock signal to control the transference of data


byte digits[10] {
  0b11111100,
  0b01100000,
  0b11011010,
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  0b11111110,
  0b11100110
};

void setup() {
  Serial.begin(115200);
  EEPROM.begin(512);
  //utc = int(EEPROM.read(0));
  EEPROM.get(0,utc);
  EEPROM.end();
  
  pinMode(dataPin, OUTPUT);
  pinMode(loadPin, OUTPUT);
  pinMode(clockPin, OUTPUT);  
  digitalWrite(loadPin, 0);
  shiftOut(dataPin, clockPin, LSBFIRST, 0b0000000000000000);
  digitalWrite(loadPin, 1);
  strip.begin();           // INITIALIZE NeoPixel strip object (REQUIRED)
  strip.show();            // Turn OFF all pixels ASAP
  strip.setBrightness(25); // Set BRIGHTNESS to about 1/5 (max = 255)
  for (int b=0; b<6; b++) {
    strip.setPixelColor(b,255,0,0);
  }
  strip.show();
  for (int b=0; b<3; b++) {
    chase();
  }

  WiFi.hostname("VFD-Clock");
  wifiManager.setHostname("VFD-Clock");
  int i=0;
  wifiManager.autoConnect("VFD WiFi Manager");
  /*
  if ( WiFi.status() != WL_CONNECTED) {
    wifiManager.autoConnect("VFD WiFi Manager");
    while (i<10) {
      i++;
      delay(500); 
    }
    if ( WiFi.status() != WL_CONNECTED) {
      wifiManager.resetSettings();
      wifiManager.setTimeout(120);
      if (!wifiManager.startConfigPortal("VFD WiFi Manager")) {
        Serial.println("failed to connect and hit timeout");
        delay(3000);
        //reset and try again, or maybe put it to deep sleep
        ESP.reset();
        delay(5000);
      }
    }
  }
  */
  //WiFi.begin(ssid, password);
  //int i=0;
  //int b=0;
  //while ( WiFi.status() != WL_CONNECTED ) {
  //  delay ( 500 );
  //  digitalWrite(loadPin, 0);
  //  shiftOut(dataPin, clockPin, LSBFIRST, digits[i]); //right
  //  shiftOut(dataPin, clockPin, LSBFIRST, digits[b]); //left
  //  digitalWrite(loadPin, 1);
  //  i++;
  //  if (i==10) {
  //    i=0;
  //    b++;
  //  }
  //  if (b==9 && i==9) {
  //    digitalWrite(loadPin, 0);
  //    shiftOut(dataPin, clockPin, LSBFIRST, 0b00001010); //right
  //    shiftOut(dataPin, clockPin, LSBFIRST, 0b10011111); //left
  //    digitalWrite(loadPin, 1);
  //    delay(10000);
  //    i=0;
  //    b=0;
  //  }
  //}
  
  timeClient.begin();
  server.begin();
  timeClient.update();
  timeClient.setUpdateInterval(86400000);

  utcOffsetInSeconds = 3600*utc;
  timeClient.setTimeOffset(utcOffsetInSeconds);
  setTime(timeClient.getEpochTime());

  //US DST CALC
  if(month() == 11 && day() < 8 && day() < weekday()) {
    dst=true;
  }
  if(month() == 11 && day() < 8 && weekday() == 1 && hour() < 1) {
    dst=true;
  }

  if(month() < 11 && month() > 3) dst = true;

  if(month() == 3 && day() > 7 && day() >= (weekday() + 7)) {
    if(!(weekday() == 1 && hour() < 2)) dst = true;
  }
 
  if(dst) utcOffsetInSeconds += 3600UL;


  //unsigned long pctime;
  //pctime = timeClient.getEpochTime(); 
  timeClient.setTimeOffset(utcOffsetInSeconds);
  setTime(timeClient.getEpochTime());
  timeout=millis()+5000;
  //newNTPreq=millis()+86400000;
  secondTick=millis()+1000;
}

void chase() {
  byte disp = 0;
  for (unsigned int j=0; j<5; j++) {
    for (unsigned int i=0; i<8; i++) {
      digitalWrite(loadPin, 0);
      bitSet(disp, i);
      shiftOut(dataPin, clockPin, LSBFIRST, disp); //right
      shiftOut(dataPin, clockPin, LSBFIRST, disp); //left
      digitalWrite(loadPin, 1);
      delay(25);
      bitClear(disp, i);
    }  
  }
}

void casino() {
  for (unsigned int i=0; i<20; i++) {
    digitalWrite(loadPin, 0);
    shiftOut(dataPin, clockPin, LSBFIRST, digits[random(0,9)]); //right
    shiftOut(dataPin, clockPin, LSBFIRST, digits[random(0,9)]); //left
    digitalWrite(loadPin, 1);
    delay(25);
  }  
}

/**
 * Map HSL color space to RGB
 * 
 * Totally borrowed from:
 * http://www.niwa.nu/2013/05/math-behind-colorspace-conversions-rgb-hsl/ 
 * 
 * Probably not the most efficient solution, but 
 * it get's the job done.
 */
uint32_t hsl(uint16_t ih, uint8_t is, uint8_t il) {

  float h, s, l, t1, t2, tr, tg, tb;
  uint8_t r, g, b;

  h = (ih % 360) / 360.0;
  s = constrain(is, 0, 100) / 100.0;
  l = constrain(il, 0, 100) / 100.0;

  if ( s == 0 ) { 
    r = g = b = 255 * l;
    return ((uint32_t)r << 16) | ((uint32_t)g <<  8) | b;
  } 
  
  if ( l < 0.5 ) t1 = l * (1.0 + s);
  else t1 = l + s - l * s;
  
  t2 = 2 * l - t1;
  tr = h + 1/3.0;
  tg = h;
  tb = h - 1/3.0;

  r = hsl_convert(tr, t1, t2);
  g = hsl_convert(tg, t1, t2);
  b = hsl_convert(tb, t1, t2);

  // NeoPixel packed RGB color
  return ((uint32_t)r << 16) | ((uint32_t)g <<  8) | b;
}
/**
 * HSL Convert
 * Helper function
 */
uint8_t hsl_convert(float c, float t1, float t2) {

  if ( c < 0 ) c+=1; 
  else if ( c > 1 ) c-=1;

  if ( 6 * c < 1 ) c = t2 + ( t1 - t2 ) * 6 * c;
  else if ( 2 * c < 1 ) c = t1;
  else if ( 3 * c < 2 ) c = t2 + ( t1 - t2 ) * ( 2/3.0 - c ) * 6;
  else c = t2;
  
  return (uint8_t)(c*255); 
}

void loop() {
  WiFiClient client = server.available();

  unsigned int b=0;
  unsigned int daySeconds = ((int)hour()*3600) + ((int)minute()*60) + (int)second();
  float dayPercentage = (((float)daySeconds/86400)*100);

  if (client) { // if !available yet, we return to this client in next loop
    char line[64];
    int l = client.readBytesUntil('\n', line, sizeof(line));
    line[l] = 0;
    client.find((char*) "\r\n\r\n");
    if (strncmp_P(line, PSTR("POST"), strlen("POST")) == 0) {
      l = client.readBytes(line, sizeof(line));
      line[l] = 0;

      // parse the parameters sent by the html form
      const char* delims = "="; //was =&
      strtok(line, delims);
      const char* value = strtok(NULL, delims);
      //strtok(NULL, delims);
      //const char* pass = strtok(NULL, delims);

      // send a response before attemting to connect to the WiFi network
      // because it will reset the SoftAP and disconnect the client station
      client.println(F("HTTP/1.1 200 OK"));
      client.println(F("Connection: close"));
      client.println(F("Refresh: 1"));
      client.println();
      client.println(F("<html><body><h3>Applying configuration</h3><br>please wait...</body></html>"));
      client.stop();

      utc=atoi(value);
      utcOffsetInSeconds = 3600*utc;

      //US DST CALC
      if(month() == 11 && day() < 8 && day() < weekday()) {
        dst=true;
      }
      if(month() == 11 && day() < 8 && weekday() == 1 && hour() < 1) {
        dst=true;
      }

      if(month() < 11 && month() > 3) dst = true;
 
      if(month() == 3 && day() > 7 && day() >= (weekday() + 7)) {
        if(!(weekday() == 1 && hour() < 2)) dst = true;
      }
 
      if(dst) utcOffsetInSeconds += 3600UL;
      
      timeClient.update();
      timeClient.setTimeOffset(utcOffsetInSeconds);
      setTime(timeClient.getEpochTime());
      EEPROM.begin(512);
      EEPROM.put(0, utc);
      //EEPROM.update(0, utc);
      //EEPROM.commit();
      EEPROM.end();
      //setTime(timeClient.getEpochTime()+utcOffsetInSeconds);
    } else {
      client.println();
      client.print(data_header_html);  
      client.print(F("Current GMT offset: "));
      client.println((utc));
      client.print(F("Current GMT offset in seconds: "));
      client.println((utcOffsetInSeconds));
      client.print(data_body_html);
      client.println();
      client.print(data_footer_html);
      client.stop();
    }    
  } else {
    //if (millis()>=newNTPreq) {
    //  newNTPreq=newNTPreq+86400000;
    //  timeClient.update();
    //  setTime(timeClient.getEpochTime()+utcOffsetInSeconds);
    //}
    if (millis()>=secondTick) {
      secondTick=millis()+1000;
      for (b=0; b<6; b++) {
        strip.setPixelColor(b, hsl(PColor, saturation, 0));
      }
      PColor++;
      if (PColor>360) {
        PColor=0;
      }
      int secondd = (second()/1U) % 10;
      int secondu = (second()/10U) % 10;
      float percent = (float)secondd/10;      
      if (secondu==0) {
        strip.setPixelColor(1, hsl(PColor, saturation, (float)((lightness*(1-percent)))));
        strip.setPixelColor(0, hsl(PColor, saturation, (float)((lightness*percent))));
      }
      if (secondu==1) {
        strip.setPixelColor(0, hsl(PColor, saturation, (float)((lightness*(1-percent)))));
        strip.setPixelColor(5, hsl(PColor, saturation, (float)((lightness*percent))));
      }
      if (secondu==2) {
        strip.setPixelColor(5, hsl(PColor, saturation, (float)((lightness*(1-percent)))));
        strip.setPixelColor(4, hsl(PColor, saturation, (float)((lightness*percent))));
      }
      if (secondu==3) {
        strip.setPixelColor(4, hsl(PColor, saturation, (float)((lightness*(1-percent)))));
        strip.setPixelColor(3, hsl(PColor, saturation, (float)((lightness*percent))));
      }
      if (secondu==4) {
        strip.setPixelColor(3, hsl(PColor, saturation, (float)((lightness*(1-percent)))));
        strip.setPixelColor(2, hsl(PColor, saturation, (float)((lightness*percent))));
      }
      if (secondu==5) {
        strip.setPixelColor(1, hsl(PColor, saturation, (float)((lightness*percent))));
        strip.setPixelColor(2, hsl(PColor, saturation, (float)((lightness*(1-percent)))));
      }
      strip.show();
    }
    if (millis()>=timeout) {
      timeout=millis()+5000;  

      unsigned int b=0;
      int Hour = hour();
      int Minute = minute();
      int Seconds = second();
      int Hour1 = (Hour/10U) % 10;
      int Hour2 = (Hour/1U) % 10;
      int Minute1 = (Minute/10U) % 10;
      int Minute2 = (Minute/1U) % 10;
      if (minTmp != Minute2) {
        chase();
      }
      minTmp = Minute2;
      digitalWrite(loadPin, 0);
      shiftOut(dataPin, clockPin, LSBFIRST, 0b0000000000000000);
      digitalWrite(loadPin, 1);
      if(displaySwitch==true) {
        //Display Hours
        displaySwitch=false;
        casino();
        digitalWrite(loadPin, 0);
        shiftOut(dataPin, clockPin, LSBFIRST, digits[Hour2]); //right
        shiftOut(dataPin, clockPin, LSBFIRST, digits[Hour1]); //left
        digitalWrite(loadPin, 1);
      } else {
        //Display Minutes
        displaySwitch=true;
        digitalWrite(loadPin, 0);
        shiftOut(dataPin, clockPin, LSBFIRST, digits[Minute2]); //right
        shiftOut(dataPin, clockPin, LSBFIRST, digits[Minute1]); //left
        digitalWrite(loadPin, 1);
      }
    }
  }
}
